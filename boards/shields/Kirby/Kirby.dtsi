left_encoder: encoder_left {
        compatible = "alps,ec11";
        label = "LEFT_ENCODER";
        a-gpios = <&gpio0 29  (GPIO_ACTIVE_HIGH | GPIO_PULL_DOWN)>;
        b-gpios = <&gpio0  2  (GPIO_ACTIVE_HIGH | GPIO_PULL_DOWN)>;
        resolution = <4>;
    };